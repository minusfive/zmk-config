
    layer_1 {
      label = "L1";
      bindings = <
// ╭───────────────┬───────────────┬───────────────┬───────────────┬───────────────┬───────────────╮   ╭───────────────┬───────────────┬───────────────┬───────────────┬───────────────┬───────────────╮
//  0               1               2               3               4               5                   6               7               8               9               10              11
    &kp ESC         &kp Q           &kp W           &kp F           &kp P           &kp B               &kp J           &kp L           &kp U           &kp Y           &kp SQT         &kp CAPSLOCK
// ├───────────────├───────────────┼───────────────┼───────────────┼───────────────┼───────────────┤   ├───────────────├───────────────┼───────────────┼───────────────┼───────────────┼───────────────┤
//  12              13              14              15              16              17                  18              19              20              21              22              23
    &bkspc_del      &kp A           &kp R           &kp S           &kp T           &kp G               &kp M           &kp N           &kp E           &kp I           &kp O           &kp ENTER
// ├───────────────├───────────────┼───────────────┼───────────────┼───────────────┼───────────────┤   ├───────────────├───────────────┼───────────────┼───────────────┼───────────────┼───────────────┤
//  24              25              26              27              28              29                  30              31              32              33              34              35
    &sl Fn          &mt LCTRL Z     &mt LALT X      &mt LCMD C      &mt MEH D       &kp V               &kp K           &mt MEH H       &mt RCMD COMMA  &mt RALT DOT   &mt RCTRL SLASH  &sl Fn
// ╰───────────────┴───────────────┴───────────────┼───────────────┼───────────────┼───────────────┤   ├───────────────├───────────────┼───────────────┼───────────────┴───────────────┴───────────────╯
//                                                  36              37              38                  39              40              41
                                                    &kp TAB         &mt LSHFT SPACE &smart_num L2 0     &smart_num L2 0 &smart_shift    &kp GRAVE
//                                                 ╰───────────────┴───────────────┴───────────────╯   ╰───────────────┴───────────────┴───────────────╯
      >;
    };